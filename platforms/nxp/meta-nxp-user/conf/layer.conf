## platforms/nxp/meta-nxp-user/conf/layer.conf
```bitbake
BBPATH .= ":${LAYERDIR}"

BBFILES += "${LAYERDIR}/recipes-*/*/*.bb \
    ${LAYERDIR}/recipes-*/*/*.bbappend \
"

BBFILE_COLLECTIONS += "meta-nxp-user"
BBFILE_PATTERN_meta-nxp-user = "^${LAYERDIR}/"
BBFILE_PRIORITY_meta-nxp-user = "6"

LAYERSERIES_COMPAT_meta-nxp-user = "scarthgap"
LICENSE_PATH += "${LAYERDIR}/licenses"
```

## platforms/raspberrypi/meta-rpi-user/conf/layer.conf
```bitbake
BBPATH .= ":${LAYERDIR}"

BBFILES += "${LAYERDIR}/recipes-*/*/*.bb \
    ${LAYERDIR}/recipes-*/*/*.bbappend \
"

BBFILE_COLLECTIONS += "meta-rpi-user"
BBFILE_PATTERN_meta-rpi-user = "^${LAYERDIR}/"
BBFILE_PRIORITY_meta-rpi-user = "6"

LAYERSERIES_COMPAT_meta-rpi-user = "scarthgap"
LICENSE_PATH += "${LAYERDIR}/licenses"
```

## platforms/rockchip/meta-rockchip-user/conf/layer.conf
```bitbake
BBPATH .= ":${LAYERDIR}"

BBFILES += "${LAYERDIR}/recipes-*/*/*.bb \
    ${LAYERDIR}/recipes-*/*/*.bbappend \
"

BBFILE_COLLECTIONS += "meta-rockchip-user"
BBFILE_PATTERN_meta-rockchip-user = "^${LAYERDIR}/"
BBFILE_PRIORITY_meta-rockchip-user = "6"

LAYERSERIES_COMPAT_meta-rockchip-user = "scarthgap"
LICENSE_PATH += "${LAYERDIR}/licenses"
```

## platforms/stm32mp/meta-stm32mp-user/conf/layer.conf
```bitbake
BBPATH .= ":${LAYERDIR}"

BBFILES += "${LAYERDIR}/recipes-*/*/*.bb \
    ${LAYERDIR}/recipes-*/*/*.bbappend \
"

BBFILE_COLLECTIONS += "meta-stm32mp-user"
BBFILE_PATTERN_meta-stm32mp-user = "^${LAYERDIR}/"
BBFILE_PRIORITY_meta-stm32mp-user = "6"

LAYERSERIES_COMPAT_meta-stm32mp-user = "scarthgap"
LICENSE_PATH += "${LAYERDIR}/licenses"
```

## platforms/tegra/meta-tegra-user/conf/layer.conf
```bitbake
BBPATH .= ":${LAYERDIR}"

BBFILES += "${LAYERDIR}/recipes-*/*/*.bb \
    ${LAYERDIR}/recipes-*/*/*.bbappend \
"

BBFILE_COLLECTIONS += "meta-tegra-user"
BBFILE_PATTERN_meta-tegra-user = "^${LAYERDIR}/"
BBFILE_PRIORITY_meta-tegra-user = "6"

LAYERSERIES_COMPAT_meta-tegra-user = "scarthgap"
LICENSE_PATH += "${LAYERDIR}/licenses"
```

## platforms/xilinx/meta-xilinx-user/conf/layer.conf
```bitbake
# We have a conf and classes directory, add to BBPATH
BBPATH .= ":${LAYERDIR}"

# We have recipes-* directories, add to BBFILES
BBFILES += "${LAYERDIR}/recipes-*/*/*.bb \
    ${LAYERDIR}/recipes-*/*/*.bbappend \
"

BBFILE_COLLECTIONS += "meta-xilinx-user"
BBFILE_PATTERN_meta-xilinx-user = "^${LAYERDIR}/"
BBFILE_PRIORITY_meta-xilinx-user = "6"

LAYERSERIES_COMPAT_meta-xilinx-user = "scarthgap"
LICENSE_PATH += "${LAYERDIR}/licenses"
```

## project-spec/meta-bsp/conf/layer.conf
```bitbake
# We have a conf and classes directory, add to BBPATH
BBPATH .= ":${LAYERDIR}"

# We have recipes-* directories, add to BBFILES
BBFILES += "${LAYERDIR}/recipes-*/*/*.bb \
	${LAYERDIR}/recipes-*/*/*.bbappend \
"

BBFILE_COLLECTIONS += "meta-bsp"
BBFILE_PATTERN_meta-bsp = "^${LAYERDIR}/"
BBFILE_PRIORITY_meta-bsp = "5"

LAYERSERIES_COMPAT_meta-bsp = "kirkstone"
LICENSE_PATH += "${LAYERDIR}/licenses"

require cis_extra.conf
```

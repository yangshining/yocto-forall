## products/xilinx-zynqmp-harp-dfe/meta-xilinx-zynqmp-harp-dfe/conf/machine/harp-dfe-xczu67dr.conf
```bitbake
require conf/machine/zynqmp-generic.conf

MACHINEOVERRIDES =. "harp-dfe-xczu67dr:"
```

## tests/fixtures/minimal/components/layers/baselines/test/meta-openembedded/meta-oe/conf/layer.conf
```bitbake
BBFILE_COLLECTIONS += "openembedded-layer"
LAYERSERIES_COMPAT_openembedded-layer = "test-series"
```

## tests/fixtures/minimal/platforms/fixture-platform/meta-fixture/conf/layer.conf
```bitbake
BBFILE_COLLECTIONS += "fixture-layer"
LAYERSERIES_COMPAT_fixture-layer = "test-series"
```
